/**
 * These arguments were used when this file was generated. They will be automatically applied on subsequent loads
 * via the GUI or CLI. Run CLI with '--help' for additional information on how to override these arguments.
 * @cliArgs --device "MSPM0G350X" --part "Default" --package "LQFP-64(PM)"
 * @v2CliArgs --device "MSPM0G3507" --package "LQFP-64(PM)"
 * @versions {"tool":"1.26.3+4558"}
 */
